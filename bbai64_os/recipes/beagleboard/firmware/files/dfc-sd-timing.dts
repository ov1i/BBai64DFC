/dts-v1/;
/plugin/;

/ {
    compatible = "ti,j721e";

    fragment@0 {
        target-path = "/mmc@4fb0000";  // main_sdhci1
        __overlay__ {
            status = "okay";
            disable-wp;
            no-1-8-v;
            max-frequency = <50000000>;
            ti,driver-strength-ohm = <50>;
        };
    };
};
