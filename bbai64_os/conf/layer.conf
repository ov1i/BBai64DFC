## bbai64_os/conf/layer.conf
```bitbake
# We have a conf and classes directory, add to BBPATH
BBPATH .= ":${LAYERDIR}"

# We have recipes-* directories, add to BBFILES
BBFILES += "${LAYERDIR}/images/*.bb \
            ${LAYERDIR}/recipes/*/*/*.bb \
            ${LAYERDIR}/recipes/*/*/*.bbappend"

BBFILE_COLLECTIONS += "bbai64_os"
BBFILE_PATTERN_bbai64_os = "^${LAYERDIR}/"
BBFILE_PRIORITY_bbai64_os = "6"

LAYERDEPENDS_bbai64_os = "core"
LAYERSERIES_COMPAT_bbai64_os = "walnascar"
```

## bbai64_os/conf/machine/dfc.conf
```bitbake
# #@TYPE: Machine
# #@NAME: BeagleBone AI-64 (A72) 
# #@DESCRIPTION: Custom machine configuration for the BeagleBone AI-64 board (A72 core)
require conf/machine/include/j721e.inc
require conf/machine/include/dfc-bsp.inc

IMAGE_SR1_1_HS_FS_FILES = ""
IMAGE_SR1_1_HS_SE_FILES = ""
IMAGE_SR2_HS_FS_FILES = ""
IMAGE_SR2_HS_SE_FILES = ""

UBOOT_MACHINE = "j721e_beagleboneai64_a72_defconfig"

UBOOT_MACHINE:bsp-ti-6_1 = "j721e_evm_a72_config"
UBOOT_CONFIG_FRAGMENTS:bsp-ti-6_1 = "j721e_beagleboneai64_a72.config"

UBOOT_MACHINE:bsp-bb_org-6_1 = "j721e_evm_a72_config"
UBOOT_CONFIG_FRAGMENTS:bsp-bb_org-6_1 = "j721e_beagleboneai64_a72.config"

SPL_BINARY = "tispl.bin_unsigned"

KERNEL_DEVICETREE_PREFIX += " ti/k3-j721e"
KERNEL_DEVICETREE = " \
ti/k3-j721e-beagleboneai64.dtb \
ti/k3-j721e-common-proc-board.dtb \
ti/k3-j721e-sk.dtb \
"

KERNEL_IMAGETYPE = "Image"
IMAGE_BOOT_FILES += " \
k3-j721e-beagleboneai64.dtb \
k3-j721e-common-proc-board.dtb \
k3-j721e-sk.dtb \
fitImage \
Image \
extlinux/extlinux.conf \
"

IMAGE_BOOT_FILES:remove =  " \
tiboot3-j721e-sr1_1-hs-fs-evm.bin \
tiboot3-j721e-sr1_1-hs-evm.bin \
tiboot3-j721e-sr2-hs-evm.bin \
tiboot3-j721e-sr2-hs-fs-evm.bin \
tiboot3-j721e-gp-evm.bin \
sysfw-j721e-sr1_1-hs-fs-evm.itb \
sysfw-j721e-sr1_1-hs-evm.itb \
sysfw-j721e-sr2-hs-fs-evm.itb \
sysfw-j721e-gp-evm.itb \
"

MACHINE_GUI_CLASS = ""
MACHINE_FEATURES:remove = "screen gpu pvr alsa pci efi"
DISTRO_FEATURES:remove = "opengl egl wayland x11"
IMAGE_FSTYPES:remove = "tar.xz wic.bmap"
IMAGE_INSTALL:remove = "ti-img-rogue-driver ti-img-rogue-umlibs"


PREFERRED_PROVIDER_virtual/gpudriver = ""
PREFERRED_PROVIDER_virtual/mesa = ""
PREFERRED_PROVIDER_virtual/egl = ""
PREFERRED_PROVIDER_virtual/libgles1 = ""
PREFERRED_PROVIDER_virtual/libgles2 = ""
PREFERRED_PROVIDER_virtual/libgles3 = ""
PREFERRED_PROVIDER_virtual/libgbm = ""
PREFERRED_PROVIDER_virtual/libglx = ""
PREFERRED_PROVIDER_virtual/libgl = ""

TI_VXE_VXD_DRIVER:bsp-bb_org-6_6 = ""
TI_VXE_VXD_DRIVER:bsp-bb_org-6_1 = ""
```

## bbai64_os/conf/machine/include/dfc-bsp.inc
```bitbake
TI_PREFERRED_BSP ?= "bb_org-6_6"

BSP_KERNEL_PROVIDER:bsp-bb_org-6_1 = "linux-bb.org"
BSP_KERNEL_VERSION:bsp-bb_org-6_1 = "6.1.%"
BSP_BOOTLOADER_PROVIDER:bsp-bb_org-6_1 = "u-boot-bb.org"
BSP_BOOTLOADER_VERSION:bsp-bb_org-6_1 = "2023.%"

# BSP_SGX_DRIVER_PROVIDER:bsp-bb_org-6_1 = "ti-sgx-ddk-km"
# BSP_SGX_DRIVER_VERSION:bsp-bb_org-6_1 = "1.17%"
# BSP_SGX_UMLIBS_VERSION:bsp-bb_org-6_1 = "1.17%"
# BSP_ROGUE_DRIVER_PROVIDER:bsp-bb_org-6_1 = "ti-img-rogue-driver"
# BSP_ROGUE_DRIVER_VERSION:bsp-bb_org-6_1 = "23%"
# BSP_ROGUE_UMLIBS_VERSION:bsp-bb_org-6_1 = "23%"
# BSP_MESA_PVR_VERSION:bsp-bb_org-6_1 = "22%"

BSP_SGX_DRIVER_PROVIDER:remove:bsp-bb_org-6_1 = "ti-sgx-ddk-km"
BSP_SGX_DRIVER_VERSION:remove:bsp-bb_org-6_1 = "1.17%"
BSP_SGX_UMLIBS_VERSION:remove:bsp-bb_org-6_1 = "1.17%"
BSP_ROGUE_DRIVER_PROVIDER:remove:bsp-bb_org-6_1 = "ti-img-rogue-driver"
BSP_ROGUE_DRIVER_VERSION:remove:bsp-bb_org-6_1 = "23%"
BSP_ROGUE_UMLIBS_VERSION:remove:bsp-bb_org-6_1 = "23%"
BSP_MESA_PVR_VERSION:remove:bsp-bb_org-6_1 = "22%"

BSP_KERNEL_PROVIDER:bsp-bb_org-6_6 = "linux-bb.org"
BSP_KERNEL_VERSION:bsp-bb_org-6_6 = "6.6.%"
BSP_BOOTLOADER_PROVIDER:bsp-bb_org-6_6 = "u-boot-bb.org"
BSP_BOOTLOADER_VERSION:bsp-bb_org-6_6 = "2024.%"

# BSP_SGX_DRIVER_PROVIDER:bsp-bb_org-6_6 = "ti-sgx-ddk-km"
# BSP_SGX_DRIVER_VERSION:bsp-bb_org-6_6 = "1.17%"
# BSP_SGX_UMLIBS_VERSION:bsp-bb_org-6_6 = "1.17%"
# BSP_ROGUE_DRIVER_PROVIDER:bsp-bb_org-6_6 = "ti-img-rogue-driver"
# BSP_ROGUE_DRIVER_VERSION:bsp-bb_org-6_6 = "24%"
# BSP_ROGUE_UMLIBS_VERSION:bsp-bb_org-6_6 = "24%"
# BSP_MESA_PVR_VERSION:bsp-bb_org-6_6 = "24%"

BSP_SGX_DRIVER_PROVIDER:remove:bsp-bb_org-6_6 = "ti-sgx-ddk-km"
BSP_SGX_DRIVER_VERSION:remove:bsp-bb_org-6_6 = "1.17%"
BSP_SGX_UMLIBS_VERSION:remove:bsp-bb_org-6_6 = "1.17%"
BSP_ROGUE_DRIVER_PROVIDER:remove:bsp-bb_org-6_6 = "ti-img-rogue-driver"
BSP_ROGUE_DRIVER_VERSION:remove:bsp-bb_org-6_6 = "24%"
BSP_ROGUE_UMLIBS_VERSION:remove:bsp-bb_org-6_6 = "24%"
BSP_MESA_PVR_VERSION:remove:bsp-bb_org-6_6 = "24%"

# GC320 support requires out-of-tree drivers not yet available
MACHINE_FEATURES:remove:bsp-bb_org-6_1 = "gc320"
MACHINE_FEATURES:remove:bsp-bb_org-6_6 = "gc320"
```
